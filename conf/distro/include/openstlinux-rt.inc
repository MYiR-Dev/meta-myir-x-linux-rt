## conf/distro/include/openstlinux-rt.inc
```bitbake
LOCALCONF_VERSION = "2"
LAYER_CONF_VERSION ?= "7"

DISTROOVERRIDES =. "openstlinuxcommonrt:"

require conf/distro/include/openstlinux-default-naming.inc
require conf/distro/include/no-static-libs.inc
require conf/distro/include/yocto-uninative.inc
INHERIT += "uninative"

DISTRO_FEATURES = ""
DISTRO_FEATURES += "argp"
DISTRO_FEATURES += "ext2"
DISTRO_FEATURES += "ext4"
DISTRO_FEATURES += "largefile"
DISTRO_FEATURES += "ipv4"
DISTRO_FEATURES += "multiarch"
DISTRO_FEATURES += "xattr"
DISTRO_FEATURES:append = " optee "
DISTRO_FEATURES:append = " autoresize "
DISTRO_FEATURES:append = " initrd "
DISTRO_FEATURES:append = " usrmerge "

DISTRO_FEATURES_BACKFILL_CONSIDERED += "pulseaudio"

IMAGE_LINGUAS = "en-gb"
IMAGE_INSTALL:append = " glibc-utils localedef "
```

## conf/distro/openstlinux-rt.conf
```bitbake
#@NAME: openstlinux-rt
#@DESCRIPTION: OpenSTLinux featuring RT

require include/openstlinux-rt.inc
require conf/distro/include/st-default-distro-rules.inc

DISTRO = "openstlinux-rt"
DISTRO_NAME = "OpenSTLinux distribution for RT feature - (A Yocto Project Based Distro)"

STM32MP_TARGETVENDOR = "-openstlinuxrt"
SDK_VENDOR = "-openstlinuxrt_sdk"
```

## conf/layer.conf
```bitbake
BBPATH .= ":${LAYERDIR}"

BBFILES += "${LAYERDIR}/recipes-*/*/*.bb \
            ${LAYERDIR}/recipes-*/*/*.bbappend"

BBFILE_COLLECTIONS += "myir-stm32mprt"
BBFILE_PATTERN_myir-stm32mprt := "^${LAYERDIR}/"
BBFILE_PRIORITY_myir-stm32mprt = "7"

LAYERSERIES_COMPAT_myir-stm32mprt = "scarthgap"
LAYERDEPENDS_myir-stm32mprt = "core openembedded-layer meta-python"

LAYERVERSION_myir-stm32mprt = "1"
ST_OSTL_COMPATIBILITY_VERSION_myir-stm32mprt = "6.2"
```
